## west.yml
```yaml
# Copyright (c) 2024 Realtek Semiconductor Corp.
# SPDX-License-Identifier: Apache-2.0

# The west manifest file for Realtek GUI SDK.

manifest:
  defaults:
    remote: aiot

  remotes:
    - name: aiot
      url-base: https://gitee.com/

  # Please add items below based on alphabetical order
  projects:
    - name: ameba-rtos
      path: sdk
      repo-path: Ameba-AIoT/ameba-rtos
      revision: master
    - name: gui
      path: sdk/component/ui
      repo-path: Ameba-AIoT/ameba-ui
      revision: master
    - name: lvgl-8.3
      path: sdk/component/ui/LVGL/lvgl-8.3/lvgl
      repo-path: Ameba-AIoT/lvgl
      revision: release/v8.3
    - name: lvgl-9.3
      path: sdk/component/ui/LVGL/lvgl-9.3/lvgl
      repo-path: Ameba-AIoT/lvgl
      revision: release/v9.3

  self:
    path: manifests
```
